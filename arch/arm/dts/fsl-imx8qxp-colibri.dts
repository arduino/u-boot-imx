// SPDX-License-Identifier: GPL-2.0+ OR X11
/*
 * Copyright 2020 Toradex
 */

/dts-v1/;

#include "fsl-imx8qxp-colibri.dtsi"
#include "fsl-imx8qxp-colibri-u-boot.dtsi"

/ {
	model = "Toradex Colibri iMX8X";
	compatible = "toradex,colibri-imx8x", "fsl,imx8qxp";
};
